## kernel/drivers/i2c/chips/Kconfig
```kconfig
#
# Miscellaneous I2C chip drivers configuration
#
# *** DEPRECATED! Do not add new entries! See Makefile ***
#

menu "Miscellaneous I2C Chip support"

config SENSORS_MT9T013
	tristate "MT9T013 Camera Driver"
	depends on I2C
	default y
	help
	 MT9T013 Camera Driver implemented by HTC.

# FEATURE_M7LAB
config SENSORS_MMC328X
	tristate "MEMSIC Magnetic Sensor Driver Support"
	depends on I2C
	help
	  If you say yes here you get support for the MEMSIC magnateic sensor

config ECOMPASS
	tristate "MEMSIC eCompass Driver Support"
	depends on I2C
	help
	  If you say yes here you get support for the MEMSIC eCompass

config BOSCH_BMA222
	tristate "BMA222 acceleration sensor support"
	depends on I2C=y
	help
	  If you say yes here you get support for Bosch Sensortec's 
	  acceleration sensors BMA222.

config BOSCH_BMA222_USE_SMBUS
	tristate "BMA222 acceleration sensor use smbus"
	depends on BOSCH_BMA222=y
	help
	  If you say yes here you use smbus for Bosch Sensortec's 
	  acceleration sensors BMA222.

config BOSCH_BMA222_WITH_DEBUG
	tristate "BMA222 acceleration sensor with debug imformation"
	depends on BOSCH_BMA222=y
	help
	  If you say yes here you get debug imformation for Bosch Sensortec's 
	  acceleration sensors BMA222.

config BOSCH_BMA222_HAS_EARLYSUSPEND
	tristate "BMA222 acceleration sensor has early suspend and late resume"
	depends on BOSCH_BMA222=y
	help
	  If you say yes here you get has early suspend and late resume for Bosch Sensortec's 
	  acceleration sensors BMA222.

config SENSORS_TAOS
	tristate "PROXIMITY LIGHT Sensor Driver Support"
	depends on I2C
	help
	  If you say yes here you get support for the MEMSIC magnateic sensor

endmenu
```
